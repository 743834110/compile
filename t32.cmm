int a, b;
a = 100;
b = a + c;
print a, b;
