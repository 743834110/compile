int y, z;
y = 2016;
z =(y + 1000) / (y - 2000);
print z;
