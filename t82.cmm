int a, b, c;
a = 200;
b = 100;
if ( a > b ) {
   c = a;
   a = b;
   b = c;
}
print a;
print b;
