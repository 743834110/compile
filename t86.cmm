int a, b;
a = 10;
b = 20;
while(a < b){
	if (a > b)
		print a;
	else
		print b;
}
